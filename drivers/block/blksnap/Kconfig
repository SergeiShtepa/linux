## drivers/block/blksnap/Kconfig
```kconfig
# SPDX-License-Identifier: GPL-2.0
#
# Snapshots of block devices configuration
#

config BLKSNAP
	tristate "Snapshots of block devices (Experimental)"
	help
	  Allow to create snapshots and track block changes for block devices.
	  It can be used to create backups of block devices. Snapshots are
	  temporary and are released when backup is completed. Change block
	  tracking allows to create incremental or differential backups.
```

## drivers/block/filters/Kconfig
```kconfig
# SPDX-License-Identifier: GPL-2.0
#
# Block device filter drivers configuration
#

menuconfig BDEVFLT
	bool "Block device filters"
	depends on BLOCK
	default y
	help
	  Say Y here to get to see options for various different block device
	  filter drivers. This option alone does not add any kernel code.

	  If you say N, all options in this submenu will be skipped and disabled;
	  only do this if you know what you are doing.

if BDEVFLT

source "drivers/block/filters/gbdevflt/Kconfig"

endif # BDEVFLT
```

## drivers/block/filters/blk_snap/Kconfig
```kconfig
# SPDX-License-Identifier: GPL-2.0
#
# Block Device Snapshot module configuration
#

config BLK_SNAP
	tristate "Block device snapshot filter"
	depends on BDEVFLT
	help
	  Allow to create snapshots and track block changes for a block
	  devices. Designed for creating backups for any block devices
	  (without device mapper). Snapshots are temporary and are released
	  then backup is completed. Change block tracking allows you to
	  create incremental or differential backups.

config BLK_SNAP_SNAPSTORE_MULTIDEV
	bool "Multi device snapstore configuration support"
	depends on BLK_SNAP
	help
	  Allow to create snapstore on multiple block devices.
```

## drivers/block/filters/gbdevflt/Kconfig
```kconfig
# SPDX-License-Identifier: GPL-2.0
#
# Generic Block Device Filter driver configuration
#

config GBDEVFLT
	tristate "Generic Block Device Filter Driver"
	help
	  This is the generic block device filter driver. It can be used with
          <some Oracle security tool>.  Say Y or M.

config GBDEVFLT_STACK_DEPTH
	int "The size of the stack that the bytecode processor is limited to."
	depends on GBDEVFLT
	default 8
	help
	  The stack is allocated on the main stack, so the smaller the better.
	  Also, there is no reason for tricky rules to filter I/O requests.

	  If the stack is suddenly missing, check the correctness of the rule
	  you created.
```
